## drivers/Kconfig
```kconfig
# SPDX-FileCopyrightText: 2026 Muhammad Waleed Badar
# SPDX-License-Identifier: Apache-2.0

rsource "udc_native_linux/Kconfig"
rsource "uhc_native_linux/Kconfig"
```

## drivers/udc_native_linux/Kconfig
```kconfig
# SPDX-FileCopyrightText: 2026 Muhammad Waleed Badar
# SPDX-License-Identifier: Apache-2.0

config UDC_NATIVE_LINUX
	bool "Native Linux USB device controller"
	default y
	depends on DT_HAS_ZEPHYR_NATIVE_POSIX_UDC_ENABLED || DT_HAS_ZEPHYR_NATIVE_LINUX_UDC_ENABLED
	depends on ARCH_POSIX
	depends on UDC_DRIVER
	select NATIVE_USE_NSI_ERRNO
	select NATIVE_SIMULATOR_PREFER_REAL_TIME
	select UDC_DRIVER_HAS_HIGH_SPEED_SUPPORT
	select UDC_WORKQUEUE
	help
	  USB device controller of native_sim (zephyr_udc0) backed by a USB
	  device controller of the Linux host, through raw-gadget.

if UDC_NATIVE_LINUX

config UDC_NATIVE_LINUX_IRQ
	int "Interrupt number of the native Linux USB device controller"
	default 5
	help
	  Raised on a bus event and when a transfer is done, shared by all
	  instances. Must differ from the other interrupts of the board, such
	  as NSOS_IRQ.

config UDC_NATIVE_LINUX_POLL_PERIOD
	int "Poll period of the native Linux USB device controller"
	default 250
	range 1 1000000
	help
	  Simulated microseconds between checks for a bus event or a finished
	  transfer. A value much shorter than the real time period
	  (--rt-period) gains nothing.

endif # UDC_NATIVE_LINUX
```

## drivers/uhc_native_linux/Kconfig
```kconfig
# SPDX-FileCopyrightText: 2026 Muhammad Waleed Badar
# SPDX-License-Identifier: Apache-2.0

config UHC_NATIVE_LINUX
	bool "Native Linux USB host controller"
	default y
	depends on DT_HAS_ZEPHYR_NATIVE_LINUX_UHC_ENABLED
	depends on ARCH_POSIX
	depends on UHC_DRIVER
	select NATIVE_USE_NSI_ERRNO
	select NATIVE_SIMULATOR_PREFER_REAL_TIME
	help
	  USB host controller of native_sim that gives the USB host stack one
	  USB device of the Linux host, through usbfs.
```

## dts/bindings/usb/zephyr,native-linux-udc.yaml
```yaml
# SPDX-FileCopyrightText: 2026 Muhammad Waleed Badar
# SPDX-License-Identifier: Apache-2.0

title: Native Linux USB device controller

description: |
  native_sim USB device controller backed by a USB device controller of the
  Linux host, through raw-gadget (/dev/raw-gadget): a hardware one, which makes
  the application a device on a USB cable, or dummy_hcd, which connects it to
  the USB host stack of the same machine.

  The driver serves the zephyr,native-posix-udc node of the board as well.
  This compatible adds the choice of the host controller to it.

  The endpoints are those of the host controller. The device is connected at
  the speed of maximum-speed, high speed when not set, or at the one of the
  USB host when that is slower.

  The host controller answers SET_ADDRESS, GET_STATUS and the endpoint halt
  requests itself, and sends the status of a control transfer with a data OUT
  stage before the stack has seen the data, which can therefore not be
  refused. Remote wakeup and start of frame events are not supported.

compatible: "zephyr,native-linux-udc"

include: usb-controller.yaml

properties:
  host-udc:
    type: string
    description: |
      Host controller, by its name in /sys/class/udc, e.g. "dummy_udc.0".
      The first one found is used when not set. Overridden by the --udc
      command line option.

examples:
  - |
      &zephyr_udc0 {
        compatible = "zephyr,native-linux-udc";
        host-udc = "dummy_udc.0";
      };
```

## dts/bindings/usb/zephyr,native-linux-uhc.yaml
```yaml
# SPDX-FileCopyrightText: 2026 Muhammad Waleed Badar
# SPDX-License-Identifier: Apache-2.0

title: Native Linux USB host controller

description: |
  native_sim USB host controller that gives the USB host stack one USB device
  of the Linux host, through usbfs (/dev/bus/usb).

  Linux has enumerated the device already and keeps its address: the driver
  answers SET_ADDRESS itself, does not pass a bus reset on, and reports the
  device as connected as soon as the controller is enabled. SET_CONFIGURATION
  goes through usbfs and is a no-op for the configuration that is active.

  The interface of an endpoint is taken from its kernel driver when the first
  transfer is sent to it, and given back when the application exits.

  Control, bulk and interrupt transfers are supported. A control transfer
  blocks the simulation until the device has answered.

compatible: "zephyr,native-linux-uhc"

include: usb-controller.yaml

properties:
  host-device:
    type: string
    description: |
      USB device of the host, as "vendor:product" in hexadecimal, e.g.
      "0483:374b", or as its usbfs node, e.g. "/dev/bus/usb/001/004".
      Overridden by the --uhc-device command line option.

examples:
  - |
      / {
        zephyr_uhc0: uhc {
          compatible = "zephyr,native-linux-uhc";
          host-device = "0483:374b";
        };
      };
```
