## CMakeLists.txt
```
# SPDX-FileCopyrightText: 2026 Muhammad Waleed Badar
# SPDX-License-Identifier: Apache-2.0

cmake_minimum_required(VERSION 3.20.0)

# The driver under test is in the Zephyr module two levels up
get_filename_component(module_dir ${CMAKE_CURRENT_SOURCE_DIR}/../.. ABSOLUTE)
list(APPEND ZEPHYR_EXTRA_MODULES ${module_dir})

find_package(Zephyr REQUIRED HINTS $ENV{ZEPHYR_BASE})
project(uhc_native_linux)

target_sources(app PRIVATE src/main.c)
```

## prj.conf
```kconfig
# SPDX-FileCopyrightText: 2026 Muhammad Waleed Badar
# SPDX-License-Identifier: Apache-2.0

CONFIG_SHELL=y
CONFIG_USB_HOST_STACK=y
CONFIG_USBH_SHELL=y
CONFIG_LOG=y
```

## app.overlay
```dts
/*
 * SPDX-FileCopyrightText: 2026 Muhammad Waleed Badar
 * SPDX-License-Identifier: Apache-2.0
 */

/ {
	zephyr_uhc0: uhc {
		compatible = "zephyr,native-linux-uhc";
	};
};
```

## src/main.c
```c
/*
 * SPDX-FileCopyrightText: 2026 Muhammad Waleed Badar
 * SPDX-License-Identifier: Apache-2.0
 */

#include <zephyr/device.h>
#include <zephyr/devicetree.h>
#include <zephyr/usb/usbh.h>

/* The USB host shell works on this controller */
USBH_CONTROLLER_DEFINE(uhs_ctx, DEVICE_DT_GET(DT_NODELABEL(zephyr_uhc0)));

int main(void)
{
	return 0;
}
```
